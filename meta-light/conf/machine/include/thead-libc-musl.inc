## meta-light/conf/machine/include/thead-libc-musl.inc
```bitbake
TARGET_VENDOR="-musl"
TCLIBC = "musl"
PREFERRED_PROVIDER_glibc = "musl"
PREFERRED_PROVIDER_virtual/libc = "musl"
PREFERRED_PROVIDER_virtual/libintl = "musl"
PREFERRED_PROVIDER_virtual/libiconv = "musl"
PREFERRED_PROVIDER_virtual/crypt = "musl"
```

## meta-light/conf/machine/light-a-public-release.conf
```bitbake
#@TYPE: Machine
#@NAME: xuantie
#@SOC: XuanTie Light
#@DESCRIPTION: Machine configuration for the Light A validation board

require conf/machine/include/thead-base.inc

SERIAL_CONSOLES = "115200;ttyS0"
MACHINE_EXTRA_RRECOMMENDS += "kernel-modules"

IMAGE_FSTYPES += "cpio.gz ext4"

# Uncomment the following two lines to always checkout the specified version of each repository
THEAD_BSP_TAG = "Linux_SDK_V1.0.2"
THEAD_LINUX_TAG = "Linux_SDK_V1.0.2"

# 指定u-boot版本
PREFERRED_PROVIDER_virtual/bootloader ?= "u-boot"
PREFERRED_VERSION_u-boot = "1:2020.10"
# UBOOT_MACHINE ?= "light_defconfig"
UBOOT_MACHINE = "light_a_val_defconfig"
SPL_BINARY = "spl/u-boot-spl"
UBOOT_ELF = "u-boot"
UBOOT_BINARY = "u-boot-with-spl.bin"


# 指定内核版本
PREFERRED_PROVIDER_virtual/kernel ?= "linux-thead"
PREFERRED_VERSION_linux-thead = "5.10.y"
KERNEL_DEVICETREE_light-a-public-release ?= "thead/light-a-val.dtb thead/light-a-val-ddr2G.dtb thead/light-a-val-ddr1G.dtb thead/light-a-val-wcn.dtb thead/light-a-val-dsi0.dtb thead/light-a-val-dsi1.dtb thead/light-a-val-hdmi.dtb thead/light-a-val-dsi0-dsi1.dtb thead/light-a-val-dsi0-hdmi.dtb thead/light-a-val-audio.dtb thead/light-a-val-iso7816.dtb thead/light-a-val-npu-fce.dtb thead/light-a-val-sv.dtb thead/light-a-val-nand.dtb thead/light-a-val-dsp0-dsp1.dtb thead/light-a-val-dpi0.dtb thead/light-a-val-dpi0-dpi1.dtb thead/light-a-val-miniapp-hdmi.dtb thead/light-a-val-gpio-keys.dtb thead/light-a-val-sec.dtb thead/light-a-val-full.dtb thead/light-a-val-khv.dtb thead/light-a-val-crash.dtb"
KBUILD_DEFCONFIG_light-a-public-release = "light_defconfig"
PREFERRED_VERSION_mesa = "21.0.1"
PREFERRED_PROVIDER_virtual/mesa_light-a-public-release ?= "mesa-proprietary"
PREFERRED_PROVIDER_virtual/libgl_light-a-public-release ?= "mesa-proprietary"
PREFERRED_PROVIDER_virtual/libgles1_light-a-public-release ?= "mesa-proprietary"
PREFERRED_PROVIDER_virtual/libgles2_light-a-public-release ?= "mesa-proprietary"
PREFERRED_PROVIDER_virtual/egl_light-a-public-release ?= "mesa-proprietary"
PREFERRED_PROVIDER_virtual/libgbm_light-a-public-release ?= "mesa-proprietary"
```

## meta-light/conf/machine/light-a-val.conf
```bitbake
#@TYPE: Machine
#@NAME: xuantie
#@SOC: XuanTie Light
#@DESCRIPTION: Machine configuration for the Light A validation board

require conf/machine/include/thead-base.inc

SERIAL_CONSOLES = "115200;ttyS0"
MACHINE_EXTRA_RRECOMMENDS += "kernel-modules"

IMAGE_FSTYPES += "cpio.gz ext4"

# Uncomment the following two lines to always checkout the specified version of each repository
THEAD_BSP_TAG = "Linux_SDK_V1.1.2"
THEAD_LINUX_TAG = "Linux_SDK_V1.1.2"

# 指定u-boot版本
PREFERRED_PROVIDER_virtual/bootloader ?= "u-boot"
PREFERRED_VERSION_u-boot = "1:2020.10"
# UBOOT_MACHINE ?= "light_defconfig"
UBOOT_MACHINE = "light_a_val_defconfig"
SPL_BINARY = "spl/u-boot-spl"
UBOOT_ELF = "u-boot"
UBOOT_BINARY = "u-boot-with-spl.bin"


# 指定内核版本
PREFERRED_PROVIDER_virtual/kernel ?= "linux-thead"
PREFERRED_VERSION_linux-thead = "5.10.y"
KERNEL_DEVICETREE:light-a-val ?= "thead/light-a-val.dtb thead/light-a-val-ddr2G.dtb thead/light-a-val-ddr1G.dtb thead/light-a-val-wcn.dtb thead/light-a-val-dsi0.dtb thead/light-a-val-dsi1.dtb thead/light-a-val-hdmi.dtb thead/light-a-val-dsi0-dsi1.dtb thead/light-a-val-dsi0-hdmi.dtb thead/light-a-val-audio.dtb thead/light-a-val-iso7816.dtb thead/light-a-val-npu-fce.dtb thead/light-a-val-sv.dtb thead/light-a-val-nand.dtb thead/light-a-val-dsp0-dsp1.dtb thead/light-a-val-dpi0.dtb thead/light-a-val-dpi0-dpi1.dtb thead/light-a-val-miniapp-hdmi.dtb thead/light-a-val-gpio-keys.dtb thead/light-a-val-sec.dtb thead/light-a-val-full.dtb thead/light-a-val-khv.dtb thead/light-a-val-crash.dtb thead/light-a-val-audio-hdmi.dtb"
KBUILD_DEFCONFIG:light-a-val = "light_defconfig"
```

## meta-light/conf/machine/light-b-public.conf
```bitbake
#@TYPE: Machine
#@NAME: xuantie
#@SOC: XuanTie Light
#@DESCRIPTION: Machine configuration for the Light B product board

require conf/machine/include/thead-base.inc

SERIAL_CONSOLES = "115200;ttyS0"
MACHINE_EXTRA_RRECOMMENDS += "kernel-modules"

IMAGE_FSTYPES += "cpio.gz ext4"

# Uncomment the following two lines to always checkout the specified version of each repository
THEAD_BSP_TAG = "Linux_SDK_V1.0.3"
THEAD_LINUX_TAG = "Linux_SDK_V1.0.3"

# 指定u-boot版本
PREFERRED_PROVIDER_virtual/bootloader ?= "u-boot"
PREFERRED_VERSION_u-boot = "1:2020.10"
# UBOOT_MACHINE ?= "light_defconfig"
UBOOT_MACHINE = "light_b_product_defconfig"
SPL_BINARY = "spl/u-boot-spl"
UBOOT_ELF = "u-boot"
UBOOT_BINARY = "u-boot-with-spl.bin"


# 指定内核版本
PREFERRED_PROVIDER_virtual/kernel ?= "linux-thead"
PREFERRED_VERSION_linux-thead = "5.10.y"
KERNEL_DEVICETREE_light-b-public = "thead/light-b-product.dtb thead/light-b-product-ddr1G.dtb thead/light-b-product-miniapp-hdmi.dtb thead/light-b-product-crash.dtb"
KERNEL_DEVICETREE_light-b-public += "thead/light-b-product-sec.dtb"
KBUILD_DEFCONFIG_light-b-public = "light_defconfig"
PREFERRED_VERSION_mesa = "21.0.1"
PREFERRED_PROVIDER_virtual/mesa_light-b-public ?= "mesa-proprietary"
PREFERRED_PROVIDER_virtual/libgl_light-b-public ?= "mesa-proprietary"
PREFERRED_PROVIDER_virtual/libgles1_light-b-public ?= "mesa-proprietary"
PREFERRED_PROVIDER_virtual/libgles2_light-b-public ?= "mesa-proprietary"
PREFERRED_PROVIDER_virtual/egl_light-b-public ?= "mesa-proprietary"
PREFERRED_PROVIDER_virtual/libgbm_light-b-public ?= "mesa-proprietary"
```

## meta-light/conf/machine/light-beagle.conf
```bitbake
#@TYPE: Machine
#@NAME: xuantie
#@SOC: XuanTie Light
#@DESCRIPTION: Machine configuration for the Light ant evt board

require conf/machine/include/thead-base.inc

SERIAL_CONSOLES = "115200;ttyS0"
MACHINE_EXTRA_RRECOMMENDS += "kernel-modules"

IMAGE_FSTYPES += "cpio.gz ext4"

# Uncomment the following two lines to always checkout the specified version of each repository
THEAD_BSP_TAG = "Linux_SDK_V1.1.2"
THEAD_LINUX_TAG = "Linux_SDK_V1.1.2"

# 指定u-boot版本
PREFERRED_PROVIDER_virtual/bootloader ?= "u-boot"
PREFERRED_VERSION_u-boot = "1:2020.10"
# UBOOT_MACHINE ?= "light_defconfig"
UBOOT_MACHINE = "light_beagle_defconfig"
SPL_BINARY = "spl/u-boot-spl"
UBOOT_ELF = "u-boot"
UBOOT_BINARY = "u-boot-with-spl.bin"


# 指定内核版本
PREFERRED_PROVIDER_virtual/kernel ?= "linux-thead"
PREFERRED_VERSION_linux-thead = "5.10.y"
KERNEL_DEVICETREE:light-beagle ?= "thead/light-beagle.dtb"
KBUILD_DEFCONFIG:light-beagle = "light_defconfig"
```

## meta-thead/conf/distro/thead-c910.conf
```bitbake
DISTRO = "thead-c910"
DISTRO_NAME = "THEAD C910 Release Distro"
DISTRO_VERSION = "1.0.3"
```
